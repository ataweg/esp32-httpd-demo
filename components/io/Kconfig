## components/io/Kconfig
```kconfig
menu "Leds & Button Configuration"

config USE_SYS_LED
        bool "Use SYS_LED"
        default N
config SYS_LED_GPIO
   int "System Led GPIO number"
     depends on USE_SYS_LED
     range 0 39
     default 25
     help
        GPIO number (IOxx) to blink on and off.
        Some GPIOs are used for other purposes (flash connections, etc.) and cannot be used to blink.
        GPIOs 35-39 are input-only so cannot be used as outputs.

config USE_INFO_LED
        bool "Use INFO_LED"
        default N
config INFO_LED_GPIO
     int "Info Led GPIO number"
     depends on USE_INFO_LED
     range 0 39
     default 26
     help
        GPIO number (IOxx) to blink on and off.
        Some GPIOs are used for other purposes (flash connections, etc.) and cannot be used to blink.
        GPIOs 35-39 are input-only so cannot be used as outputs.

config USE_WPS_BTN
        bool "Use WPS_BTN"
        default N
config WPS_BTN_GPIO
   int "Button GPIO number"
     depends on USE_WPS_BTN
     range 0 39
     default 0
     help
        GPIO number (IOxx) for button.
        Some GPIOs are used for other purposes (flash connections, etc.) and cannot be used to blink.
        GPIOs 35-39 are input-only so cannot be used as outputs.

endmenu
```

## main/Kconfig
```kconfig
menu "Web Server Configuration"

config WIFI_SSID
    string "WiFi SSID"
    default ""
    help
        SSID (network name) for the demo to connect to.

config WIFI_PASSWORD
    string "WiFi Password"
    default ""
    help
        Password for your network.

config XCLK_FREQ
    int "XCLK Frequency"
    default "8000000"
    help
        The XCLK Frequency in Hertz.

config LED_GPIO
   int "Led GPIO number"
     range 0 34
     default 2
     help
        GPIO number (IOxx) to blink on and off.
        Some GPIOs are used for other purposes (flash connections, etc.) and cannot be used to blink.
        GPIOs 35-39 are input-only so cannot be used as outputs.

config BTN_GPIO
   int "Button GPIO number"
     range 0 34
     default 0
     help
        GPIO number (IOxx) for button.
        Some GPIOs are used for other purposes (flash connections, etc.) and cannot be used to blink.
        GPIOs 35-39 are input-only so cannot be used as outputs.

endmenu
```
